## src/drivers/dxl_arm/Kconfig
```kconfig
menuconfig DRIVERS_DXL_ARM
	bool "dxl_arm"
	default n
	---help---
		Dynamixel Protocol 2.0 driver and joint-space Delta arm motion controller.

menuconfig USER_DXL_ARM
	bool "dxl_arm running as userspace module"
	default n
	depends on BOARD_PROTECTED && DRIVERS_DXL_ARM
	---help---
		Put dxl_arm in userspace memory
```

## src/modules/delta_arm_fake/Kconfig
```kconfig
menuconfig MODULES_DELTA_ARM_FAKE
	bool "delta_arm_fake"
	default n
	---help---
		Publish valid downward 90-degree Delta joint angles for policy testing without arm hardware.
```

## src/modules/mc_uav_delta/Kconfig
```kconfig
menuconfig MODULES_MC_UAV_DELTA
	bool "mc_uav_delta"
	default n
	depends on LIB_RL_TOOLS
	---help---
		Enable the UAV Delta recurrent controller with raw three-dimensional joint feedback.

menuconfig USER_MC_UAV_DELTA
	bool "mc_uav_delta running as userspace module"
	default n
	depends on BOARD_PROTECTED && MODULES_MC_UAV_DELTA
	---help---
		Put mc_uav_delta in userspace memory
```
